## drivers/video/fbdev/owl/Kconfig
```kconfig
menuconfig VIDEO_OWL
	bool "OWL video support"
	depends on ARCH_OWL
        help
	  Actions OWL Soc video support.

if VIDEO_OWL
source "drivers/video/fbdev/owl/dss/Kconfig"
source "drivers/video/fbdev/owl/vce/Kconfig"
source "drivers/video/fbdev/owl/vde/Kconfig"
source "drivers/video/fbdev/owl/hde/Kconfig"
endif
```

## drivers/video/fbdev/owl/dss/Kconfig
```kconfig
source "drivers/video/fbdev/owl/dss/core/Kconfig"
source "drivers/video/fbdev/owl/dss/de/Kconfig"
source "drivers/video/fbdev/owl/dss/controller/Kconfig"
source "drivers/video/fbdev/owl/dss/panel/Kconfig"
source "drivers/video/fbdev/owl/dss/fb/Kconfig"
source "drivers/video/fbdev/owl/dss/adf/Kconfig"
```
